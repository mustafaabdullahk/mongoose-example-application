## CMakeLists.txt
```
#-------------------------------------------------------------------------------
# Zephyr Example Application
#
# Copyright (c) 2021 Nordic Semiconductor ASA
# SPDX-License-Identifier: Apache-2.0

cmake_minimum_required(VERSION 3.13.1)
find_package(Zephyr REQUIRED HINTS $ENV{ZEPHYR_BASE})

project(app LANGUAGES C)

add_definitions(-DMG_TLS_MBED=1)

target_sources(app PRIVATE src/main.c)
```

## sample.yaml
```
# This file is provided so that the application can be compiled using Twister,
# the Zephyr testing tool. In this file, multiple combinations can be specified,
# so that you can easily test all of them locally or in CI.
sample:
  description: Example application
  name: example-application 
common:
  build_only: true
  integration_platforms:
    - stm32h747i_disco/stm32h747xx/m7
tests:
  app.default: {}
  app.debug:
    extra_overlay_confs:
      - debug.conf
```

## prj.conf
```kconfig
# Copyright (c) 2021 Nordic Semiconductor ASA
# SPDX-License-Identifier: Apache-2.0
#
# This file contains selected Kconfig options for the application.

CONFIG_SENSOR=y

# General config

CONFIG_ISR_STACK_SIZE=2048
CONFIG_IDLE_STACK_SIZE=1024
CONFIG_MAIN_STACK_SIZE=4096
CONFIG_HEAP_MEM_POOL_SIZE=16384
CONFIG_SYS_CLOCK_TICKS_PER_SEC=1000000

CONFIG_THREAD_NAME=y
CONFIG_THREAD_LOCAL_STORAGE=y

CONFIG_MONGOOSE=y

# Log settings
CONFIG_PRINTK=y
CONFIG_LOG=y

# POSIX options
CONFIG_POSIX_MAX_FDS=32

# General config
CONFIG_MINIMAL_LIBC=y
CONFIG_MINIMAL_LIBC_RAND=y
CONFIG_COMMON_LIBC_MALLOC_ARENA_SIZE=32768

# Generic networking options
CONFIG_NETWORKING=y

# Networking config
CONFIG_NETWORKING=y
CONFIG_NET_IPV4=y
CONFIG_NET_IPV6=y
CONFIG_NET_TCP=y
CONFIG_NET_UDP=y
CONFIG_NET_SOCKETS=y
CONFIG_NET_SOCKETS_POLL_MAX=32
CONFIG_NET_SOCKETS_POSIX_NAMES=y
CONFIG_NET_CONTEXT_RCVTIMEO=y
CONFIG_NET_CONTEXT_SNDTIMEO=y
CONFIG_NET_MAX_CONN=20
CONFIG_NET_MAX_CONTEXTS=20
CONFIG_NET_STATISTICS=y
CONFIG_NET_CONNECTION_MANAGER=y
CONFIG_NET_HOSTNAME_ENABLE=y
CONFIG_NET_HOSTNAME_UNIQUE=y

# Network buffers
# Attention! consumed 150kb of ram
CONFIG_NET_PKT_RX_COUNT=96
CONFIG_NET_PKT_TX_COUNT=96
CONFIG_NET_BUF_RX_COUNT=128
CONFIG_NET_BUF_TX_COUNT=128
CONFIG_NET_TX_STACK_SIZE=2048
CONFIG_NET_RX_STACK_SIZE=2048
CONFIG_NET_DEBUG_NET_PKT_ALLOC=y
CONFIG_NET_TC_TX_COUNT=1
CONFIG_NET_TC_RX_COUNT=1

CONFIG_NET_CONTEXT_NET_PKT_POOL=y
CONFIG_NET_TCP_TIME_WAIT_DELAY=0
CONFIG_NET_BUF_POOL_USAGE=y

# Network debug config
CONFIG_NET_LOG=n
CONFIG_NET_SHELL=n

# Kernel options
CONFIG_ENTROPY_GENERATOR=y
CONFIG_TEST_RANDOM_GENERATOR=y

# DHCP config
CONFIG_INIT_STACKS=y
CONFIG_NET_LOG=y
CONFIG_NET_ARP=y
CONFIG_NET_DHCPV4=y
CONFIG_NET_DHCPV4_OPTION_CALLBACKS=y
CONFIG_NET_MGMT=y
CONFIG_NET_MGMT_EVENT=y
CONFIG_NET_MGMT_EVENT_INFO=y
CONFIG_NET_MGMT_EVENT_LOG_LEVEL_DBG=n

# Network address config
CONFIG_NET_CONFIG_AUTO_INIT=y
CONFIG_NET_CONFIG_SETTINGS=y
CONFIG_NET_CONFIG_NEED_IPV4=y
# static ip configs
CONFIG_NET_CONFIG_MY_IPV4_ADDR="10.5.190.191"
CONFIG_NET_CONFIG_PEER_IPV4_ADDR="10.5.190.192"
CONFIG_NET_CONFIG_MY_IPV4_GW="10.5.190.192"
CONFIG_NET_L2_ETHERNET=y


# This is needed so that the sample app can respond to queries
# as fast as possible.
CONFIG_NET_TCP_TIME_WAIT_DELAY=0

# mbedtls configs
CONFIG_MBEDTLS=y
CONFIG_MBEDTLS_ECDH_C=y
CONFIG_MBEDTLS_ECDSA_C=y
CONFIG_MBEDTLS_ECJPAKE_C=y
CONFIG_MBEDTLS_ECP_C=y
CONFIG_MBEDTLS_SSL_MAX_CONTENT_LEN=2048
CONFIG_MBEDTLS_PEM_CERTIFICATE_FORMAT=y
CONFIG_MBEDTLS_KEY_EXCHANGE_ECDHE_ECDSA_ENABLED=y
CONFIG_MBEDTLS_ECP_ALL_ENABLED=y
```

## src/main.c
```c
// Copyright (c) 2020 Cesanta Software Limited
// All rights reserved

#include "certs.h"

#include <mongoose.h>

static const char *s_web_dir = "/";
static const char *s_http_addr = "http://0.0.0.0:8000";
static const char *s_https_addr = "https://0.0.0.0:8443";
static time_t s_boot_timestamp = 0;
static struct mg_connection *s_sntp_conn = NULL;

// Event handler for the listening HTTP/HTTPS connection.
static void wcb(struct mg_connection *c, int ev, void *ev_data)
{
	if (ev == MG_EV_ACCEPT && c->fn_data != NULL) {
		struct mg_tls_opts opts = {.cert = s_ssl_cert, .key = s_ssl_key};
		mg_tls_init(c, &opts);
	} else if (ev == MG_EV_HTTP_MSG) {
		struct mg_http_message *hm = ev_data;
		MG_INFO(("%.*s %.*s %ld", (int)hm->method.len, hm->method.ptr,
				 (int)hm->uri.len, hm->uri.ptr, (long)hm->body.len));
		if (mg_http_match_uri(hm, "/api/#")) { // REST API requests
			// Print some statistics about currently established connections
			mg_printf(c, "HTTP/1.1 200 OK\r\nTransfer-Encoding: chunked\r\n\r\n");
			mg_http_printf_chunk(c, "ID PROTO TYPE      LOCAL           REMOTE\n");
			for (struct mg_connection *t = c->mgr->conns; t != NULL; t = t->next) {
				mg_http_printf_chunk(c, "%-3lu %4s %s %M %M\n", t->id,
									 t->is_udp ? "UDP" : "TCP",
									 t->is_listening  ? "LISTENING"
									 : t->is_accepted ? "ACCEPTED "
													  : "CONNECTED",
									 mg_print_ip, &t->loc, mg_print_ip, &t->rem);
			}
			mg_http_printf_chunk(c, ""); // Don't forget the last empty chunk
		} else {
			struct mg_http_serve_opts opts = {.root_dir = s_web_dir}; // Serve
			mg_http_serve_dir(c, hm, &opts);						  // static files
		}
	} else if (ev == MG_EV_OPEN) {
		// c->is_hexdumping = 1;
	}
}

// example system time()-like function
time_t ourtime(time_t *tp)
{
	time_t t = s_boot_timestamp + mg_millis() / 1000;
	if (tp != NULL)
		*tp = t;
	return t;
}

// SNTP callback. Modifies s_boot_timestamp, to make ourtime() correct
static void sfn(struct mg_connection *c, int ev, void *ev_data)
{
	if (ev == MG_EV_SNTP_TIME) {
		int64_t t = *(int64_t *)ev_data;
		MG_INFO(("Got SNTP time: %lld ms from epoch", t));
		s_boot_timestamp = (time_t)((t - mg_millis()) / 1000);
	} else if (ev == MG_EV_CLOSE) {
		s_sntp_conn = NULL;
	}
}

// Periodic timer syncs time via SNTP
static void timer_fn(void *arg)
{
	struct mg_mgr *mgr = (struct mg_mgr *)arg;
	if (s_sntp_conn == NULL)
		s_sntp_conn = mg_sntp_connect(mgr, NULL, sfn, NULL);
	if (s_boot_timestamp < 9999)
		mg_sntp_request(s_sntp_conn);
}

// Zephyr: Define a semaphore and network management callback to be able to wait
// until our IP address is ready. The main function will start and block on this
// semaphore until this event handler releases it when the network is ready
K_SEM_DEFINE(run, 0, 1);

static void zeh(struct net_mgmt_event_callback *cb, uint32_t mgmt_event,
				struct net_if *iface)
{
	if (mgmt_event == NET_EVENT_IPV4_ADDR_ADD)
		k_sem_give(&run);
}

int main(void)
{
	// Zephyr: Register the network management callback and block on the semaphore
	struct net_mgmt_event_callback ncb;
	net_mgmt_init_event_callback(&ncb, zeh, NET_EVENT_IPV4_ADDR_ADD);
	net_mgmt_add_event_callback(&ncb);
	k_sem_take(&run, K_FOREVER);

	struct mg_mgr mgr;

	mg_log_set(MG_LL_DEBUG);

	mg_mgr_init(&mgr);
	mg_http_listen(&mgr, s_http_addr, wcb, NULL);
	mg_http_listen(&mgr, s_https_addr, wcb, &mgr);

	mg_timer_add(&mgr, 5000, MG_TIMER_REPEAT | MG_TIMER_RUN_NOW, timer_fn, &mgr);

	// Start infinite event loop
	MG_INFO(("Mongoose version : v%s", MG_VERSION));
	MG_INFO(("Listening on     : %s", s_http_addr));
	MG_INFO(("Listening on     : %s", s_https_addr));
	MG_INFO(("Web root         : [%s]", s_web_dir));
	for (;;) mg_mgr_poll(&mgr, 1000);
	mg_mgr_free(&mgr);

	return 0;
}
```
